/* Variable definitions for ESP32ULP linker
 * This file is generated automatically by esp32ulp_mapgen.py utility.
 */

PROVIDE ( ulp_entry = 0x50000000 );
PROVIDE ( ulp_exit = 0x50000034 );
PROVIDE ( ulp_high_thr = 0x50000050 );
PROVIDE ( ulp_last_result = 0x50000054 );
PROVIDE ( ulp_wake_up = 0x50000038 );
